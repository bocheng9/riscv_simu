## rootfs/buildroot_defconfig
```kconfig
# RV32IMA 最小配置（纯 rv32ima + zicsr + zifencei，无 C、无 F/D）
# 目标：产出 V3（RV32IMA + Zicsr + Zifencei）可直接执行的 rootfs

# ---- 目标架构 ----
BR2_riscv=y
BR2_RISCV_32=y
BR2_RISCV_ISA_RVI=y
BR2_RISCV_ISA_RVM=y
BR2_RISCV_ISA_RVA=y
# 不选 RVC / RVF / RVD / RVV
BR2_RISCV_ABI_ILP32=y

# ---- 工具链：Buildroot 自建 ----
BR2_TOOLCHAIN_BUILDROOT=y
BR2_TOOLCHAIN_BUILDROOT_UCLIBC=y
BR2_TOOLCHAIN_BUILDROOT_CXX=n
BR2_TOOLCHAIN_BUILDROOT_FORTRAN=n
BR2_TOOLCHAIN_BUILDROOT_USE_SSP=n

# GCC 版本
BR2_GCC_VERSION_13_X=y

# 不生成 PIE
BR2_TOOLCHAIN_BUILDROOT_NO_PIE=y

# ---- 系统配置 ----
BR2_TARGET_GENERIC_HOSTNAME="rvsimu"
BR2_TARGET_GENERIC_ISSUE="RVSIMU_V3 RV32IMA"
BR2_INIT_BUSYBOX=y
BR2_ROOTFS_DEVICE_CREATION_STATIC=y

# ---- 静态 busybox ----
BR2_PACKAGE_BUSYBOX=y
BR2_STATIC_LIBS=y

# ---- 根文件系统：initramfs cpio ----
BR2_TARGET_ROOTFS_CPIO=y
BR2_TARGET_ROOTFS_CPIO_GZIP=y
BR2_TARGET_ROOTFS_CPIO_UIMAGE=n
BR2_TARGET_ROOTFS_INITRAMFS=y

# ---- 精简 ----
BR2_STRIP_strip=y
BR2_PACKAGE_KMOD=n
BR2_PACKAGE_BUSYBOX_SHOW_OTHERS=n

# 并行度（内存 7GB，保守用 -j2）
BR2_JLEVEL=2
```
